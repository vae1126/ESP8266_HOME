## components/led_control/Kconfig
```kconfig
menu "Device Configuration"

    # ==================== PWM RGB 灯 ====================
    menu "PWM RGB Light"
        config DEVICE_TYPE_LIGHT_PWM_RGB
            bool "Enable PWM RGB Light"
            default n

        config PWM_RGB_COUNT
            int "Number of PWM RGB Lights"
            range 1 2
            default 1
            depends on DEVICE_TYPE_LIGHT_PWM_RGB

        config PWM_RGB_1_R_GPIO
            int "RGB1 Red GPIO"
            range 0 16
            default 4
            depends on DEVICE_TYPE_LIGHT_PWM_RGB

        config PWM_RGB_1_G_GPIO
            int "RGB1 Green GPIO"
            range 0 16
            default 5
            depends on DEVICE_TYPE_LIGHT_PWM_RGB

        config PWM_RGB_1_B_GPIO
            int "RGB1 Blue GPIO"
            range 0 16
            default 12
            depends on DEVICE_TYPE_LIGHT_PWM_RGB

        config PWM_RGB_1_ACTIVE_HIGH
            bool "RGB1 Active High (Common Cathode)"
            default y
            depends on DEVICE_TYPE_LIGHT_PWM_RGB
    endmenu

    # ==================== 单色灯 ====================
    menu "PWM Single Color Light"
        config DEVICE_TYPE_LIGHT_PWM_SINGLE
            bool "Enable PWM Single Color Light"
            default n

        config PWM_SINGLE_COUNT
            int "Number of Single Lights"
            range 1 8
            default 1
            depends on DEVICE_TYPE_LIGHT_PWM_SINGLE

        config PWM_SINGLE_1_GPIO
            int "Single1 GPIO"
            range 0 16
            default 2
            depends on DEVICE_TYPE_LIGHT_PWM_SINGLE

        config PWM_SINGLE_1_ACTIVE_HIGH
            bool "Single1 Active High"
            default y
            depends on DEVICE_TYPE_LIGHT_PWM_SINGLE

        config PWM_SINGLE_2_GPIO
            int "Single2 GPIO"
            range 0 16
            default 5
            depends on DEVICE_TYPE_LIGHT_PWM_SINGLE && PWM_SINGLE_COUNT >= 2

        config PWM_SINGLE_2_ACTIVE_HIGH
            bool "Single2 Active High"
            default y
            depends on DEVICE_TYPE_LIGHT_PWM_SINGLE && PWM_SINGLE_COUNT >= 2
    endmenu

    # ==================== WS2812 灯带 ====================
    menu "WS2812 LED Strip"
        config DEVICE_TYPE_LIGHT_WS2812
            bool "Enable WS2812 LED Strip"
            default n

        config WS2812_COUNT
            int "Number of WS2812 Strips"
            range 1 2
            default 1
            depends on DEVICE_TYPE_LIGHT_WS2812

        config WS2812_1_GPIO
            int "WS2812-1 GPIO"
            range 0 16
            default 3
            depends on DEVICE_TYPE_LIGHT_WS2812

        config WS2812_1_NUM
            int "WS2812-1 LED count"
            range 1 256
            default 16
            depends on DEVICE_TYPE_LIGHT_WS2812
    endmenu

    # ==================== 继电器/开关 ====================
    menu "Switch/Relay"
        config DEVICE_TYPE_SWITCH
            bool "Enable Switch/Relay"
            default n

        config SWITCH_COUNT
            int "Number of Switches"
            range 1 8
            default 1
            depends on DEVICE_TYPE_SWITCH

        config SWITCH_1_GPIO
            int "Switch1 GPIO"
            range 0 16
            default 2
            depends on DEVICE_TYPE_SWITCH

        config SWITCH_1_ACTIVE_HIGH
            bool "Switch1 Active High"
            default n
            depends on DEVICE_TYPE_SWITCH

        config SWITCH_2_GPIO
            int "Switch2 GPIO"
            range 0 16
            default 5
            depends on DEVICE_TYPE_SWITCH && SWITCH_COUNT >= 2

        config SWITCH_2_ACTIVE_HIGH
            bool "Switch2 Active High"
            default n
            depends on DEVICE_TYPE_SWITCH && SWITCH_COUNT >= 2

        config SWITCH_3_GPIO
            int "Switch3 GPIO"
            range 0 16
            default 12
            depends on DEVICE_TYPE_SWITCH && SWITCH_COUNT >= 3

        config SWITCH_3_ACTIVE_HIGH
            bool "Switch3 Active High"
            default n
            depends on DEVICE_TYPE_SWITCH && SWITCH_COUNT >= 3

        config SWITCH_4_GPIO
            int "Switch4 GPIO"
            range 0 16
            default 13
            depends on DEVICE_TYPE_SWITCH && SWITCH_COUNT >= 4

        config SWITCH_4_ACTIVE_HIGH
            bool "Switch4 Active High"
            default n
            depends on DEVICE_TYPE_SWITCH && SWITCH_COUNT >= 4
    endmenu

endmenu
```

## components/mqtt_ha/Kconfig
```kconfig
config MQTT_BROKER_URL
    string "MQTT Broker URL"
    default "mqtt://47.121.26.212:1883"
    help
        MQTT broker address in mqtt://host:port format.
        Can be overridden at runtime via device command.
```

## components/status_led/Kconfig
```kconfig
menu "Status LED"

    config STATUS_LED_ENABLE
        bool "Enable Status LED"
        default n
        help
            Enable status LED that blinks in different patterns
            to indicate current device state.

    config STATUS_LED_GPIO
        int "Status LED GPIO"
        range 0 16
        default 2
        depends on STATUS_LED_ENABLE

    config STATUS_LED_ACTIVE_HIGH
        bool "Status LED Active High"
        default y
        depends on STATUS_LED_ENABLE
        help
            y = LED on when GPIO high
            n = LED on when GPIO low

endmenu
```

## components/switch_control/Kconfig
```kconfig
menu "Switch Configuration"

    config DEVICE_TYPE_SWITCH
        bool "Enable Switch/Relay Device"
        default y
        help
            Enable switch/relay device control via GPIO.

    config SWITCH_COUNT
        int "Number of switches"
        depends on DEVICE_TYPE_SWITCH
        range 1 8
        default 1
        help
            Number of switch/relay devices (1-8).

    config SWITCH_1_GPIO
        int "Switch 1 GPIO"
        depends on DEVICE_TYPE_SWITCH
        default 4
        help
            GPIO pin for switch 1.

    config SWITCH_1_ACTIVE_HIGH
        bool "Switch 1 Active High"
        depends on DEVICE_TYPE_SWITCH
        default y
        help
            When enabled, GPIO high = switch ON. When disabled, GPIO low = switch ON.

    config SWITCH_2_GPIO
        int "Switch 2 GPIO"
        depends on DEVICE_TYPE_SWITCH && SWITCH_COUNT >= 2
        range 0 16
        default 5
        help
            GPIO pin for switch 2.

    config SWITCH_2_ACTIVE_HIGH
        bool "Switch 2 Active High"
        depends on DEVICE_TYPE_SWITCH && SWITCH_COUNT >= 2
        default y

    config SWITCH_3_GPIO
        int "Switch 3 GPIO"
        depends on DEVICE_TYPE_SWITCH && SWITCH_COUNT >= 3
        range 0 16
        default 12
        help
            GPIO pin for switch 3.

    config SWITCH_3_ACTIVE_HIGH
        bool "Switch 3 Active High"
        depends on DEVICE_TYPE_SWITCH && SWITCH_COUNT >= 3
        default y

    config SWITCH_4_GPIO
        int "Switch 4 GPIO"
        depends on DEVICE_TYPE_SWITCH && SWITCH_COUNT >= 4
        range 0 16
        default 13
        help
            GPIO pin for switch 4.

    config SWITCH_4_ACTIVE_HIGH
        bool "Switch 4 Active High"
        depends on DEVICE_TYPE_SWITCH && SWITCH_COUNT >= 4
        default y

    config SWITCH_5_GPIO
        int "Switch 5 GPIO"
        depends on DEVICE_TYPE_SWITCH && SWITCH_COUNT >= 5
        range 0 16
        default 14
        help
            GPIO pin for switch 5.

    config SWITCH_5_ACTIVE_HIGH
        bool "Switch 5 Active High"
        depends on DEVICE_TYPE_SWITCH && SWITCH_COUNT >= 5
        default y

    config SWITCH_6_GPIO
        int "Switch 6 GPIO"
        depends on DEVICE_TYPE_SWITCH && SWITCH_COUNT >= 6
        range 0 16
        default 15
        help
            GPIO pin for switch 6.

    config SWITCH_6_ACTIVE_HIGH
        bool "Switch 6 Active High"
        depends on DEVICE_TYPE_SWITCH && SWITCH_COUNT >= 6
        default y

    config SWITCH_7_GPIO
        int "Switch 7 GPIO"
        depends on DEVICE_TYPE_SWITCH && SWITCH_COUNT >= 7
        range 0 16
        default 16
        help
            GPIO pin for switch 7.

    config SWITCH_7_ACTIVE_HIGH
        bool "Switch 7 Active High"
        depends on DEVICE_TYPE_SWITCH && SWITCH_COUNT >= 7
        default y

    config SWITCH_8_GPIO
        int "Switch 8 GPIO"
        depends on DEVICE_TYPE_SWITCH && SWITCH_COUNT >= 8
        range 0 16
        default 2
        help
            GPIO pin for switch 8.

    config SWITCH_8_ACTIVE_HIGH
        bool "Switch 8 Active High"
        depends on DEVICE_TYPE_SWITCH && SWITCH_COUNT >= 8
        default y

endmenu
```

## sdkconfig.defaults
```kconfig
# ESP8266 Switch Home Firmware - Default Configuration

# MQTT Broker
CONFIG_MQTT_BROKER_URL="mqtt://47.121.26.212:1883"

# Log level (INFO)
CONFIG_LOG_DEFAULT_LEVEL=3
CONFIG_LOG_DEFAULT_LEVEL_INFO=y
CONFIG_LOG_MAXIMUM_LEVEL=3
CONFIG_LOG_MAXIMUM_LEVEL_INFO=y

# Device type: Switch/Relay
CONFIG_DEVICE_TYPE_SWITCH=y
CONFIG_SWITCH_COUNT=1
CONFIG_SWITCH_1_GPIO=4
CONFIG_SWITCH_1_ACTIVE_HIGH=y

CONFIG_COMPILER_CXX_ENABLED=n
CONFIG_COMPILER_CXX_EXCEPTIONS=n
CONFIG_PTHREAD_TASK_COND_ENABLE=y
CONFIG_NEWLIB_ENABLE_PTHREAD_COND=y
```
